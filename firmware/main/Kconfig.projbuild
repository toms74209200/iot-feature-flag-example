## firmware/main/Kconfig.projbuild
```kconfig
menu "Wi-Fi Configuration"

    config ESP_WIFI_SSID
        string "WiFi SSID"
        default "myssid"
        help
            SSID (network name) for the example to connect to.

    config ESP_WIFI_PASSWORD
        string "WiFi Password"
        default "mypassword"
        help
            WiFi password (WPA or WPA2) for the example to use.

endmenu

menu "NTP Configuration"

    config NTP_SERVER_ADDRESS
        string "NTP Server Address"
        default "pool.ntp.org"
        help
            NTP server address to use for time synchronization.

    config TIMEZONE
        string "Timezone"
        default "GMT"
        help
            Timezone to use for local time calculation. Timezone format should be in POSIX format.

endmenu

menu "MQTT Configuration"

    config BROKER_DOMAIN
        string "Broker domain"
        default "mqtt.eclipseprojects.io"
        help
            Domain of the broker to connect to

    config BROKER_PORT
        int "Broker domain"
        default 1883
        help
            Port of the broker to connect to

endmenu
```
